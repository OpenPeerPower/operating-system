## buildroot-external/Config.in
```kconfig
source "$BR2_EXTERNAL_OPPOS_PATH/package/oppio/Config.in"
source "$BR2_EXTERNAL_OPPOS_PATH/package/bluetooth-bcm43xx/Config.in"
source "$BR2_EXTERNAL_OPPOS_PATH/package/bluetooth-rtl8723/Config.in"
source "$BR2_EXTERNAL_OPPOS_PATH/package/hardkernel-boot/Config.in"
source "$BR2_EXTERNAL_OPPOS_PATH/package/qemu-guest-agent/Config.in"
source "$BR2_EXTERNAL_OPPOS_PATH/package/intel-e1000e/Config.in"
source "$BR2_EXTERNAL_OPPOS_PATH/package/rpi-eeprom/Config.in"
source "$BR2_EXTERNAL_OPPOS_PATH/package/rtl8812au/Config.in"
```

## buildroot-external/package/hassio/Config.in
```kconfig
menuconfig BR2_PACKAGE_OPPIO
	bool "Supervisor App"
	help
	  This is the Application layer they build the
	  data partition with configurations.

	  https://github.com/open-peer-power/supervisor

if BR2_PACKAGE_OPPIO

config BR2_PACKAGE_OPPIO_ARCH
	string "Supervisor Arch"
	help
	  Supervisor architecture which should be pull.

endif
```
